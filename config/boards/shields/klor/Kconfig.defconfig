## config/boards/shields/klor/Kconfig.defconfig
```kconfig
if SHIELD_KLOR_DONGLE

config LV_Z_MEM_POOL_SIZE
    default 8192
config I2C
    default y

config SSD1306
    default y

choice ZMK_DISPLAY_WORK_QUEUE
    default ZMK_DISPLAY_WORK_QUEUE_DEDICATED
endchoice

config ZMK_KEYBOARD_NAME
    default "KLOR DOngLED"

config ZMK_SPLIT_ROLE_CENTRAL
    default y

config ZMK_SPLIT
    default y

config ZMK_SPLIT_BLE_CENTRAL_PERIPHERALS
    default 2

# Set this to ZMK_SPLIT_BLE_CENTRAL_PERIPHERALS + your desired number of BT profiles (default is 5)
config BT_MAX_CONN
    default 6

# Set this to the same number as BT_MAX_CONN
config BT_MAX_PAIRED
    default 6

endif # DONGLE

if SHIELD_KLOR_LEFT || SHIELD_KLOR_RIGHT

    config ZMK_SPLIT
        default y

endif # LEFT RIGHT

if ZMK_DISPLAY

choice ZMK_DISPLAY_STATUS_SCREEN
    default ZMK_DISPLAY_STATUS_SCREEN_CUSTOM
endchoice

config ZMK_DISPLAY_STATUS_SCREEN_CUSTOM
    select LV_USE_LABEL
    select LV_USE_IMG
    select LV_USE_CANVAS
    select LV_USE_ANIMIMG 
    select LV_USE_ANIMATION
    select LV_USE_LINE 
    select LV_FONT_UNSCII_8
    select ZMK_WPM
    imply ZMK_HID_INDICATORS

endif

if LVGL

config LV_Z_VDB_SIZE
    default 64

config LV_DPI_DEF
    default 148

config LV_Z_BITS_PER_PIXEL
    default 1

choice LV_COLOR_DEPTH
    default LV_COLOR_DEPTH_1
endchoice

endif
```
